// SPDX-License-Identifier: GPL-2.0
/dts-v1/;
#include "exynos4412-n710x.dtsi"

&ea8061 {
	status = "okay";
};

&dsi_in_ea8061 {
	status = "okay";
};

&dsi_out {
	status = "okay";
	remote-endpoint = <&dsi_in_ea8061>;
};
